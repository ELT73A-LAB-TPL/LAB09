/*
 * Blink
 * Turns on an LED on for one second,
 * then off for one second, repeatedly.
 */

#include <Arduino.h>
#include "stm32f4xx_hal.h" // For HAL functions and structs

#ifndef LED_BUILTIN
#define LED_BUILTIN PC13
#endif

#define INTERRUPT_PIN PA0

// Global flag (must be declared volatile)
volatile bool interrupt_flag = false;

// --- Interrupt Service Routine (ISR) ---
void handle_interrupt()
{
  // Set the flag to true. Keep the ISR code minimal and fast!
  interrupt_flag = true;
}

// This is your custom clock setup, generated by CubeMX or modified HAL code
extern "C" void SystemClock_Config(void)
{
  RCC_OscInitTypeDef RCC_OscInitStruct = {0};
  RCC_ClkInitTypeDef RCC_ClkInitStruct = {0};

  /** Configure the main internal regulator output voltage
   */
  __HAL_RCC_PWR_CLK_ENABLE();
  __HAL_PWR_VOLTAGESCALING_CONFIG(PWR_REGULATOR_VOLTAGE_SCALE1);

  /** Initializes the RCC Oscillators according to the specified parameters
   * in the RCC_OscInitTypeDef structure.
   */
  RCC_OscInitStruct.OscillatorType = RCC_OSCILLATORTYPE_HSI;
  RCC_OscInitStruct.HSIState = RCC_HSI_ON;
  RCC_OscInitStruct.HSICalibrationValue = RCC_HSICALIBRATION_DEFAULT;
  RCC_OscInitStruct.PLL.PLLState = RCC_PLL_NONE;
  if (HAL_RCC_OscConfig(&RCC_OscInitStruct) != HAL_OK)
  {
    Error_Handler();
  }

  /** Initializes the CPU, AHB and APB buses clocks
   */
  RCC_ClkInitStruct.ClockType = RCC_CLOCKTYPE_HCLK | RCC_CLOCKTYPE_SYSCLK | RCC_CLOCKTYPE_PCLK1 | RCC_CLOCKTYPE_PCLK2;
  RCC_ClkInitStruct.SYSCLKSource = RCC_SYSCLKSOURCE_HSI;
  RCC_ClkInitStruct.AHBCLKDivider = RCC_SYSCLK_DIV1;
  RCC_ClkInitStruct.APB1CLKDivider = RCC_HCLK_DIV1;
  RCC_ClkInitStruct.APB2CLKDivider = RCC_HCLK_DIV1;

  if (HAL_RCC_ClockConfig(&RCC_ClkInitStruct, FLASH_LATENCY_3) != HAL_OK)
  {
    /* User can add his own implementation to report the HAL error return state */
    __disable_irq();
    while (1)
    {
    }
  }
}

void setup()
{
  // Your code here. SystemClock_Config is called before setup().
  // initialize LED digital pin as an output.
  pinMode(LED_BUILTIN, OUTPUT);
  digitalWrite(LED_BUILTIN, HIGH); // LED OFF

  // 2. Initialize the INTERRUPT pin
  // Use INPUT_PULLUP if the button connects the pin to GND.
  pinMode(INTERRUPT_PIN, INPUT_PULLUP);

  // 3. Attach the interrupt
  // digitalPinToInterrupt(pin) maps the Arduino pin number to the correct EXTI line.
  // FALLING mode triggers the interrupt when the button is pressed (HIGH to LOW).
  attachInterrupt(digitalPinToInterrupt(INTERRUPT_PIN), handle_interrupt, FALLING);
}

void loop()
{

  // Check the volatile flag set by the ISR
  if (interrupt_flag)
  {
    // Clear the flag immediately
    interrupt_flag = false;

    // Execute the main interrupt logic
    digitalWrite(LED_BUILTIN, !digitalRead(LED_BUILTIN)); // Toggle the LED

    // Other non-time-critical code can run here
    delay(10); // Debounce delay
  }
}
